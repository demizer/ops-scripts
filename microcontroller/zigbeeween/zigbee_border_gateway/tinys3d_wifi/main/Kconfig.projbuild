## microcontroller/zigbeeween/zigbee_border_gateway/tinys3d_wifi/main/Kconfig.projbuild
```kconfig
menu "TinyS3 WiFi Controller Configuration"

    config ESP_WIFI_SSID
        string "WiFi SSID"
        default "alvaone"
        help
            SSID (network name) for the WiFi network to connect to.

    config ESP_WIFI_PASSWORD
        string "WiFi Password"
        default ""
        help
            WiFi password (WPA or WPA2) for the network.

endmenu
```

## microcontroller/zigbeeween/zigbee_border_gateway/tinys3d_wifi/sdkconfig.defaults
```kconfig
# Flash size for TinyS3 (UnexpectedMaker ESP32-S3)
CONFIG_ESPTOOLPY_FLASHSIZE_8MB=y
CONFIG_ESPTOOLPY_FLASHSIZE="8MB"

# LWIP settings for web server
CONFIG_LWIP_MAX_SOCKETS=16

# Enable ICMP (ping) support
CONFIG_LWIP_ICMP=y

# Partition table
CONFIG_PARTITION_TABLE_CUSTOM=y
CONFIG_PARTITION_TABLE_CUSTOM_FILENAME="partitions.csv"
```

## microcontroller/zigbeeween/zigbee_border_gateway/xiaoc6_zigbee/sdkconfig.defaults
```kconfig
# Flash size for XIAO ESP32-C6 (Seeed Studio)
CONFIG_ESPTOOLPY_FLASHSIZE_4MB=y
CONFIG_ESPTOOLPY_FLASHSIZE="4MB"

# Partition table
CONFIG_PARTITION_TABLE_CUSTOM=y
CONFIG_PARTITION_TABLE_CUSTOM_FILENAME="partitions.csv"

# Zigbee stack
CONFIG_ZB_ENABLED=y
```

## microcontroller/zigbeeween/zigbee_controller/sdkconfig.defaults
```kconfig
# WiFi settings (MUST be configured!)
CONFIG_ESP_WIFI_SSID=""
CONFIG_ESP_WIFI_PASSWORD=""

# Flash size for TinyC6 (UnexpectedMaker ESP32-C6)
CONFIG_ESPTOOLPY_FLASHSIZE_4MB=y
CONFIG_ESPTOOLPY_FLASHSIZE="4MB"

# LWIP settings for web server
CONFIG_LWIP_MAX_SOCKETS=16

# Enable ICMP (ping) support
CONFIG_LWIP_ICMP=y

# Partition table
CONFIG_PARTITION_TABLE_CUSTOM=y
CONFIG_PARTITION_TABLE_CUSTOM_FILENAME="partitions.csv"

# Zigbee stack
CONFIG_ZB_ENABLED=y
```

## microcontroller/zigbeeween/zigbee_rip_tombstone/sdkconfig.defaults
```kconfig
CONFIG_ZB_ENABLED=y
CONFIG_PARTITION_TABLE_CUSTOM=y
CONFIG_PARTITION_TABLE_CUSTOM_FILENAME="partitions.csv"

# Set log level to INFO (disable DEBUG logs)
CONFIG_LOG_DEFAULT_LEVEL_INFO=y
CONFIG_LOG_MAXIMUM_LEVEL_INFO=y
```
